## kernel/2.6.18/arch/arm/mach-mmsp2/Kconfig
```kconfig
menu "MagicEyes MMSP2 Implementations"
depends on ARCH_MMSP2

choice
        prompt "Select target board"

config MACH_GP2X
        bool "GP2X Portable Console"
        help
          Say Y here if you intend to run this kernel on the GameparkHoldings GP2X portable console.
endchoice

endmenu
```

## kernel/linux/arch/arm/mach-mp2520f/Kconfig
```kconfig
choice
        prompt "Board Type"
        default MACH_GP2X
		
config MACH_GP2X
	bool "GP2X Portable Console"
	select MP25XXF_SHADOW_ENABLE
	help
	  Say Y here if you intend to run this kernel on the GameparkHoldings GP2X portable console.

endchoice
```

## kernel/linux/arch/arm/plat-mp25xxf/Kconfig
```kconfig
if PLAT_MP25XXF

choice
	prompt "System Type"
	default ARCH_MP2520F

config	ARCH_MP2520F
	bool "MP2520F (MMSP2) SoC"

config	ARCH_MP2530F
	bool "MP2530/31F (MMSP2+) SoC"

endchoice

source "arch/arm/mach-mp2520f/Kconfig"
source "arch/arm/mach-mp2530f/Kconfig"

config MP25XXF_SHADOW_ENABLE
	depends on ARCH_MP2520F
	bool  "Enable Shadow Config Pin"
	help
	  Enable support for Shadow Config Pin of the CPU (Memory Configuration)

endif
```

## trunk/kernel/2.6.18/arch/arm/mach-mmsp2/Kconfig
```kconfig
menu "MagicEyes MMSP2 Implementations"
depends on ARCH_MMSP2

choice
	prompt "Select target board"

config MACH_GP2X
	bool "GP2X Portable Console"
	select MMSP2_SHADOW_ENABLE
	help
	  Say Y here if you intend to run this kernel on the GameparkHoldings GP2X portable console.
endchoice

endmenu

config MMSP2_SHADOW_ENABLE
	depends on ARCH_MMSP2
	bool  "Enable Shadow Config Pin"
	help
	  Enable support for Shadow Config Pin of the CPU (Memory Configuration)
```

## trunk/kernel/linux/arch/arm/plat-mp25xxf/Kconfig
```kconfig
if ARCH_MP25XXF

choice
	prompt "System Type"
	default ARCH_MP2520F

config	ARCH_MP2520F
	bool "MP2520F (MMSP2) SoC"

config	ARCH_MP2530F
	bool "MP2530/31F (MMSP2+) SoC"

endchoice

choice
	prompt "Board Type"

config MACH_GP2X
	bool "GP2X Portable Console"
	depends on ARCH_MP2520F
	select MMSP2_SHADOW_ENABLE
	help
	  Say Y here if you intend to run this kernel on the GameparkHoldings GP2X portable console.
endchoice

config MMSP2_SHADOW_ENABLE
	depends on ARCH_MP2520F
	bool  "Enable Shadow Config Pin"
	help
	  Enable support for Shadow Config Pin of the CPU (Memory Configuration)

endif
```
